## main/Kconfig.projbuild
```kconfig
menu "Sensor VPD - Configuracao"

    config MAJU_I2C_SDA_GPIO
        int "GPIO do SDA (I2C)"
        default 21
        help
            GPIO21 no conector J3 da ESP32-DevKitC V4. Nao e pino de strapping.

    config MAJU_I2C_SCL_GPIO
        int "GPIO do SCL (I2C)"
        default 22
        help
            GPIO22 no conector J3 da ESP32-DevKitC V4. Nao e pino de strapping.

    config MAJU_I2C_FREQ_HZ
        int "Frequencia do barramento I2C (Hz)"
        default 100000
        range 10000 100000
        help
            O MLX90614 e um dispositivo SMBus e limita o barramento a 100 kHz.
            Todos os sensores (SHT35, MLX90614, AMG8833) compartilham este barramento.

    config MAJU_SHT35_ADDR_0X45
        bool "SHT35 no endereco 0x45 (pino ADDR em VDD)"
        default n
        help
            Por padrao o pino ADDR fica em GND e o endereco e 0x44.
            Marque esta opcao apenas se o seu breakout fixa ADDR em VDD.

    config MAJU_AMG8833_ADDR_0X68
        bool "AMG8833 no endereco 0x68 (AD_SELECT em GND)"
        default n
        help
            Por padrao o AD_SELECT fica em VDD e o endereco e 0x69 (breakouts Adafruit/GY).
            Marque apenas se o seu modulo fixa AD_SELECT em GND.
            O MLX90614 usa o endereco fixo 0x5A.

    config MAJU_PRINT_THERMAL_MAP
        bool "Imprimir o mapa 8x8 do AMG8833 no monitor serial"
        default y
        help
            Mostra a matriz termica (graus Celsius) a cada leitura, abaixo da tabela.

    config MAJU_SAMPLE_INTERVAL_MS
        int "Intervalo entre leituras (ms)"
        default 20000
        range 1000 600000
        help
            20 s e o intervalo do planejamento (limite do ThingSpeak free e 1 envio / 15 s).

endmenu
```
